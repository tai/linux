## arch/arm/mach-celestial/Kconfig
```kconfig
menu "Cavium Celestials platform type"
	depends on ARCH_CELESTIAL
choice
	prompt "Celestial platform Series SoC Version"
	depends on ARCH_CELESTIAL
	default MACH_CELESTIAL_CNC1800H

config MACH_CELESTIAL_CNC1201
	bool "Cavium Celestial CNC1201 SoC"
	select CPU_ARM926T
	help
	  Include support for the Cavium Celestial CNC1201 platform.

config MACH_CELESTIAL_CNC1800H
	bool "Cavium Celestial CNC1800H SoC"
	select CPU_ARM926T
	help
	  Include support for the Cavium Celestial CNC1800H platform.

config MACH_CELESTIAL_CNC1800L
	bool "Cavium Celestial CNC1800L SoC"
	select CPU_V6 
	help
	  Include support for the Cavium Celestial CNC1800L platform.
endchoice

config CELESTIAL_TIGA_MINI
	bool "Config for Celestial Tiga-Mini board"
	depends on MACH_CELESTIAL_CNC1800L
	default n
	help
	  If select this option, will use memory defines for Tiga-Mini board 

config CELESTIAL_MEM_SIZE
	depends on ARCH_CELESTIAL
	int "Maximum Memory size (MB)"
	range 128 1024
	default "256"

menu "Default Pinmux Setting"
	depends on ARCH_CELESTIAL
config PINMUX_UART2_DEFAULT_ENABLE
	bool "UART2 Enable"
	default n

endmenu

endmenu
```

## drivers/celestial/Kconfig
```kconfig
# drivers/celestial/Kconfig

menu "Celestial Device Drivers"

source "drivers/celestial/df/Kconfig"

source "drivers/celestial/xport/Kconfig"

source "drivers/celestial/video/Kconfig"

source "drivers/celestial/audio/Kconfig"

source "drivers/celestial/peripheral/Kconfig"

source "drivers/celestial/graphics/Kconfig"

source "drivers/celestial/hdmi/Kconfig"

endmenu
```

## drivers/celestial/audio/Kconfig
```kconfig
# drivers/celestial/audio/Kconfig

menu "Celestial Audio Drivers"

config CELESTIAL_AUDIO
	bool "CSM1800L Audio"
	depends on ARCH_CELESTIAL
	default y
	help 
	    Include support drvier for Audio of celestial platform

config AUDIO_NUM
	int "Audio Number"
	depends on CELESTIAL_AUDIO
	range 1 8
	default 1
	help
	    Number of audio supported by audio decoder. Range from 1 to 8.

config AUDIO_CAB_SIZE
	hex "Audio CAB Size"
	depends on CELESTIAL_AUDIO
	range 0x18000 0x400000
	default 0x18000
	help
	    Compressed audio buffer size for one audio. Range from 0x18000 to 0x400000.

config CELESTIAL_AUDIO_DEBUG
	bool "Audio Debugging"
	depends on CELESTIAL_AUDIO
	help
	    This turns on low-level debugging for the celestial audio driver.
	    Normally, you should say 'N'.


config AUDIO_DEBUG_VERBOSE
	int "Audio Debugging verbosity (0 = quiet, 3 = noisy)"
	depends on CELESTIAL_AUDIO_DEBUG
	default "0"
	help
	    Determines the verbosity level of the audio debugging messages.

endmenu
```

## drivers/celestial/df/Kconfig
```kconfig
menu "Celestial DF Drivers"
	
if ARCH_CELESTIAL
config CELESTIAL_DF
	bool "CNC1800L Display"
	depends on ARCH_CELESTIAL
	default y
	help 
	Include support drvier for DF of celestial platform
endif

if ARCH_CELESTIALSEMI
config CELESTIAL_DF
	bool "CNC1800H Display"
	depends on ARCH_CELESTIALSEMI
	default y
	help 
	Include support drvier for DF of celestial platform
endif

if CELESTIAL_DF
config HD2SD_ENABLE
	bool "CNC1800L HD2SD Function"
	depends on CELESTIAL_DF
	default y
	help
	Enable HD2SD function. It will use 0x5a0000 Bytes memory.
endif

config CELESTIAL_DF_DEBUG
       bool "DF Debugging"
       depends on CELESTIAL_DF
       help
         This turns on low-level debugging for the celestial df driver.
           Normally, you should say 'N'.


config DF_DEBUG_VERBOSE
       int "DF Debugging verbosity (0 = quiet, 3 = noisy)"
       depends on CELESTIAL_DF_DEBUG
       default "0"
       help
         Determines the verbosity level of the df debugging messages.

endmenu
```

## drivers/celestial/graphics/Kconfig
```kconfig
#
# Character device configuration
#

menu "Celestial Graphics driver"

config CELESTIAL_GRAPHICS
	bool "GRAPHICS(2D)"
	depends on ARCH_CELESTIAL
	default y
    help 
      Include support drvier for graphic of celestial platform

config CELESTIAL_GRAPHICS_DEBUG
       bool "Debugging 2D graphics engine"
       depends on CELESTIAL_GRAPHICS
       help
         This turns on low-level debugging for the celestial graphics driver.
           Normally, you should say 'N'.


config GRAPHICS_DEBUG_VERBOSE
       int "2D Engine Debugging verbosity (0 = quiet, 3 = noisy)"
       depends on CELESTIAL_GRAPHICS_DEBUG
       default "0"
       help
         Determines the verbosity level of the Graphics debugging messages.

endmenu
```

## drivers/celestial/hdmi/Kconfig
```kconfig
menu "Celestial HDMI Drivers"
	
config CELESTIAL_HDMI
	bool "CNC1800L HDMI Driver"
	depends on ARCH_CELESTIAL
	default n
	help 
		HDMI driver for cnc1800l

endmenu
```

## drivers/celestial/peripheral/Kconfig
```kconfig
#
# Character device configuration
#

menu "Celestial Platform peripheral devices"

config CELESTIAL_SCI
	bool "Smart Card"
	depends on ARCH_CELESTIAL
	default y
    help 
      Include support drvier for smartcard of celestial platform

config CELESTIAL_SCI_DEBUG
       bool "Debugging Smart Card"
       depends on CELESTIAL_SCI
       help
         This turns on low-level debugging for the celestial Smart Card driver.
           Normally, you should say 'N'.


config SCI_DEBUG_VERBOSE
       int "Smart Card Debugging verbosity (0 = quiet, 3 = noisy)"
       depends on CELESTIAL_SCI_DEBUG
       default "0"
       help
         Determines the verbosity level of the SCI debugging messages.

config CELESTIAL_I2C
	bool "I2C"
	depends on ARCH_CELESTIAL
	default y
    help
      Include support drvier for I2C of celestial platform

config CNC18XX_I2C_DEV2
	bool "I2C_TWO"
	depends on ARCH_CELESTIAL
	default n
    help
      Include support drvier for I2C2 of celestial platform
 
config CELESTIAL_I2C_DEBUG
    bool "Debugging I2C device"
    depends on CELESTIAL_I2C
    help
      This turns on low-level debugging for clestial I2C driver.
           Normally, you should say 'N'.
    
config I2C_DEBUG_VERBOSE
       int "I2C Debugging verbosity (0 = quiet, 3 = noisy)"
       depends on CELESTIAL_I2C_DEBUG
       default "0"
       help
         Determines the verbosity level of the I2C debugging messages.

config CNC18XX_I2C_EEPROM
	bool "I2C based EEPROM support"
	depends on CELESTIAL_I2C
	help 
		Include support driver for EEPROM which is based I2C on celestial platform


config CNC18XX_I2C_EEPROM_CHIP_1_ADDR
       hex  "EEPROM i2c address"
       depends on CNC18XX_I2C_EEPROM
       default 0x50

config CNC18XX_I2C_EEPROM_SUBADDR_LEN
       int  "EEPROM sub address length (in bytes)"
       depends on CNC18XX_I2C_EEPROM
       default 2

config CNC18XX_I2C_EEPROM_PAGE_SIZE
       int  "EEPROM page size (in bytes)"
       depends on CNC18XX_I2C_EEPROM
       default 32

config CNC18XX_I2C_EEPROM_SLEEP_TIME
       int  "EEPROM wait time after write (in milliseconds)."
       depends on CNC18XX_I2C_EEPROM
       default 5


config CNC18XX_I2C_MULTI_EEPROM
	bool "Support MULTI EEPROM on I2C"
	depends on CNC18XX_I2C_EEPROM
	help 
		Include support Multi EEPROMs on celestial platform


config CNC18XX_I2C_EEPROM_CHIP_2_ADDR
       hex  "Second EEPROM i2c address"
       depends on CNC18XX_I2C_MULTI_EEPROM
       default 0x54

config CNC18XX_I2C_EEPROM_2_SUBADDR_LEN
       int  "Second EEPROM sub address length (in bytes)"
       depends on CNC18XX_I2C_EEPROM && CNC18XX_I2C_MULTI_EEPROM
       default 2

config CNC18XX_I2C_EEPROM_2_PAGE_SIZE
       int  "Second EEPROM page size (in bytes)"
       depends on CNC18XX_I2C_EEPROM && CNC18XX_I2C_MULTI_EEPROM
       default 256

config CNC18XX_I2C_EEPROM_2_SLEEP_TIME
       int  "Second EEPROM wait time after write (in milliseconds)."
       depends on CNC18XX_I2C_EEPROM && CNC18XX_I2C_MULTI_EEPROM
       default 5


config CELESTIAL_GPIO
	bool	"GPIO driver"
	depends on ARCH_CELESTIAL
	default y
    help        
      Include support drvier for GPIO of celestial platform

config GPIO_INTERRUPT_SUPPORT
	bool "GPIO interrupt"
	depends on CELESTIAL_GPIO
	default n
	help 
		Support GPIO interrupts

config VGA_SWITCHER_SUPPORT
	bool "vga switcher"
	depends on GPIO_INTERRUPT_SUPPORT
	default n
	help 
		Support VGA Switcher Function by using GPIO interrupt



config CELESTIAL_FPC
	bool "FPC driver"
	depends on ARCH_CELESTIAL
	select CELESTIAL_GPIO
	default y
    help
      Include support drvier for FPC of celestial platform


config CELESTIAL_WDT
	bool "WatchDog driver"
	depends on ARCH_CELESTIAL
	default y
    help
      Include support drvier for WatchDog of celestial platform

config CELESTIAL_SEC
	bool "Secure driver"
	depends on ARCH_CELESTIAL
	default y
    help
      Include support drvier for Secure id of celestial platform


endmenu
```

## drivers/celestial/video/Kconfig
```kconfig
menu "Celestial Video Drivers"

if ARCH_CELESTIAL
config CELESTIAL_VIDEO
	bool "CNC1800L Video"
	depends on ARCH_CELESTIAL
	default y
	help 
	    Include support drvier for video of celestial platform.
endif

if ARCH_CELESTIALSEMI
config CELESTIAL_VIDEO
	bool "CSM1800H Video"
	depends on ARCH_CELESTIALSEMI
	default y
	help 
	    Include support drvier for Video of celestial platform.
endif

config VIDEO_NUM
	int "Video Number"
	depends on CELESTIAL_VIDEO
	range 1 2
	default 1
	help
	    The number of video supported by video decoder, can be set to 1 or 2.

config VIDEO_CPB_SIZE
	hex "Video CPB Size"
	depends on CELESTIAL_VIDEO
	range 0x400000 0x1000000
	default 0x400000
	help
	    Compressed picture buffer size of one video, range from 0x400000 to 0xc00000.

config CELESTIAL_VIDEO_DEBUG
	bool "Video Debugging"
	depends on CELESTIAL_VIDEO
	help
	    This turns on low-level debugging for the celestial video driver.
	    Normally, you should say 'N'.


config VIDEO_DEBUG_VERBOSE
	int "VIDEO Debugging verbosity (0 = quiet, 3 = noisy)"
	depends on CELESTIAL_VIDEO_DEBUG
	default "0"
	help
	    Determines the verbosity level of the video debugging messages.

endmenu
```

## drivers/celestial/xport/Kconfig
```kconfig
# drivers/celestial/xport/Kconfig

menu "Celestial Xport Drivers"


config CELESTIAL_XPORT
	bool "Xport drive"
	depends on ARCH_CELESTIAL
	default n
	help
	Include support driver for Xport of celestial platform

config CELESTIAL_XPORT_DEBUG
	bool "Debugging"
	depends on CELESTIAL_XPORT
	help
	This turns on low-level debugging for the celestial xport driver.
	Normally, you should say 'N'.


config XPORT_DEBUG_VERBOSE
	int "Debugging verbosity (0 = quiet, 3 = noisy)"
	depends on CELESTIAL_XPORT_DEBUG
	default "0"
	help
	Determines the verbosity level of the xport debugging messages.


endmenu
```

## drivers/video/celestial/Kconfig
```kconfig
config FB_CELESTIAL
	tristate "Celestial CNC platform framebuffer support"
	depends on FB && ARCH_CELESTIAL
	select FB_CFB_FILLRECT
	select FB_CFB_COPYAREA
	select FB_CFB_IMAGEBLIT
	select CELESTIAL_GFX_ARGB_MODE if MACH_CELESTIAL_CNC1800L=y
	help
	  Frame buffer driver for the celestial platform.

config FB0_SIZE
	hex "Default size of frame buffer 0"
	depends on FB_CELESTIAL
	range 0x800000 0x4000000
	default "0x1000000"
	help
	    size of frame buffer 0, which is used for OSD Layer 0, frame buffer 2 is included in this buffer. range from 0x800000 to 0x1000000

config FB2_SIZE
	hex "Default size of frame buffer 2"
	depends on FB_CELESTIAL
	range 0x400000 0x4000000
	default "0x800000"
	help
	    size of frame buffer 2, it's included in frame buffer 0, set to half size of fb 0 is recommended. range from 0x400000 to 0x800000

config CNC1800H_GFX_ENABLE_ARGB
	bool "Celestial CNC1800H GFX support ARGB Mode"
	depends on FB_CELESTIAL && MACH_CELESTIAL_CNC1800H
	select CELESTIAL_GFX_ARGB_MODE
	default n
	help
	    Frame buffer/GFX enable ARGB8888 mode, this mode on CNC1800H has bug, left start address must be even. So if you want to use this mode, must care for the this cases. Default Mode is BGRA8888(which is no problem)

config FORCE_TWO_OSD_LAYER
	bool "Force CNC1800H 2 osd layers support"
	depends on FB_CELESTIAL && (CELESTIALSEMI_MEM_SIZE = 256) && MACH_CELESTIAL_CNC1800H
	default n
	help
	    Force 2 OSD layer support on CNC1800H, if n, for 32bit ture color mode only 1 osd layer support, for 16bit support 2 osd layer. if y, the driver is forced to support 2 osd layer for 32bit or 16bit color mode. 

config TWO_OSD_LAYER_SUPPORT
	bool "Make CNC1800L 2 Graphic Layers support"
	depends on FB_CELESTIAL && ( (CELESTIAL_MEM_SIZE = 256) || (CELESTIAL_MEM_SIZE = 512) || (CELESTIAL_MEM_SIZE = 1024))
	default y
	help
	    CNC1800L support 2 Graphic Layers, if want to save memory and not use second OSD layer, the second OSD can be close. if n, the frambuffer 1 will the same devide with frambuffer 0.

config FB1_SIZE
	hex "Default size of frame buffer 1"
	depends on FB_CELESTIAL && TWO_OSD_LAYER_SUPPORT
	range 0x800000 0x4000000
	default "0x1000000"
	help
	    size of frame buffer 1, which is used for OSD Layer 1, frame buffer 3 is included in this buffer. range from 0x800000 to 0x1000000.

config FB3_SIZE
	hex "Default size of frame buffer 3"
	depends on FB_CELESTIAL && TWO_OSD_LAYER_SUPPORT
	range 0x400000 0x4000000
	default "0x800000"
	help
	    size of frame buffer 3, it's included in frame buffer 1, set to half size of fb 1 is recommended. range from 0x400000 to 0x800000.

config CELESTIAL_GFX_ARGB_MODE
	tristate
	depends on FB && ARCH_CELESTIAL
	default n
	help
	    GFX is set default to ARGB mode!
```
